/* these are test fixtures for the find_rotation_and_scale_of_ellipse function */


/* simple - in axes(0,1), major axis is (1,0), scale is 2 */
double simple1[][3] = {
    {2,0,0},
    {-2,0,0},
    {0,1.00,0},
    {0,-1.00,0}
};

double simple2[][3] = {
    {10.6453,0.,0.4649},
    {-6.5173,0.,-7.6269},
    {0.9093,0.,-11.1258},
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    {-10.2187,0.,-1.985}
};

double simple3[][3] = {
    {0.,-5.1998,-9.9883},
    {0.,2.24,11.5609},
    {0.,7.9695,-7.6379},
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    {0.,-5.6049,-9.6598}
};

double simple4[][3] = {
    {-5.9531,-9.8795,0.},
    {8.1289,7.338,0.},
    {9.2457,4.998,0.},
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    {-5.2188,-10.4394,0.}
};

double cal1[] = {
    11.12606142,-9.8869869,8.1552822,
    3.62688931,-10.57350305,-10.41600463,
    -7.38107686,-10.39778238,-7.17038565,
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    -2.59947457,-14.24631947,1.61627052
};

