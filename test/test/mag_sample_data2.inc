double mag_sample_data[] = {
43.96833801269531, -30.7659969329834, 7.100878715515137,
90.57211303710938, 11.456308364868164, 20.928905487060547,
46.057029724121094, 55.171016693115234, 12.628730773925781,
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63.28474426269531, 35.716033935546875, 76.40394592285156,
};

double grav_sample_data[] = {
-0.015239257365465164, -0.5204858183860779, -0.8436914086341858,
0.6480822563171387, 0.024569092318415642, -0.7401074171066284,
-0.023314209654927254, 0.6036535501480103, -0.8093273639678955,
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0.6512255668640137, 0.12883667647838593, 0.740063488483429,
};
