/*
******************************************************************************
File:     main.c
Info:     Generated by Atollic TrueSTUDIO(R) 8.1.0   2020-09-16

The MIT License (MIT)
Copyright (c) 2009-2017 Atollic AB

Permission is hereby granted, free of charge, to any person obtaining a copy
of this software and associated documentation files (the "Software"), to deal
in the Software without restriction, including without limitation the rights
to use, copy, modify, merge, publish, distribute, sublicense, and/or sell
copies of the Software, and to permit persons to whom the Software is
furnished to do so, subject to the following conditions:

The above copyright notice and this permission notice shall be included in all
copies or substantial portions of the Software.

THE SOFTWARE IS PROVIDED "AS IS", WITHOUT WARRANTY OF ANY KIND, EXPRESS OR
IMPLIED, INCLUDING BUT NOT LIMITED TO THE WARRANTIES OF MERCHANTABILITY,
FITNESS FOR A PARTICULAR PURPOSE AND NONINFRINGEMENT. IN NO EVENT SHALL THE
AUTHORS OR COPYRIGHT HOLDERS BE LIABLE FOR ANY CLAIM, DAMAGES OR OTHER
LIABILITY, WHETHER IN AN ACTION OF CONTRACT, TORT OR OTHERWISE, ARISING FROM,
OUT OF OR IN CONNECTION WITH THE SOFTWARE OR THE USE OR OTHER DEALINGS IN THE
SOFTWARE.

******************************************************************************
*/

/* Includes */
#include <stddef.h>
#include <stdio.h>
#include <string.h>
#include "bluenrg_x_device.h"
#include "BlueNRG1_sysCtrl.h"
#include "BlueNRG1_gpio.h"
#include "beep.h"
#include "BlueNRG1_conf.h"
#include "ble_const.h"
#include "bluenrg1_stack.h"
#include "chat.h"
#include "clock.h"
#include "Chat_config.h"
#include "hal_types.h"
#include "uart.h"
#include "my_utils.h"
#include "gatt_db.h"
/* Private typedef */

/* Private define  */

/* Private macro */

/* Private variables */
volatile uint32_t lSystickCounter=0;

/* Private function prototypes */

/* Private functions */

/**
**===========================================================================
**
**  Abstract: main program
**
**===========================================================================
*/


int main(void)
{
  uint8_t ret;
  char buffer[BUF_SIZE];
  const char *bt_text;
  SystemInit();
  uart_init();
  uart_send_response("Hello there!\n", 20);
  beep_init();
  beep_start(250);
  /* TODO - Add your application code here */
  /* BlueNRG-1 stack init */
  ret = BlueNRG_Stack_Initialization(&BlueNRG_Stack_Init_params);
  if (ret != BLE_STATUS_SUCCESS) {
    //printf("Error in BlueNRG_Stack_Initialization() 0x%02x\r\n", ret);
    while(1);
  }

  //printf("BlueNRG-1 serial\n");

  /* Init Chat Device */
  ret = CHAT_DeviceInit();
  if (ret != BLE_STATUS_SUCCESS) {
    //printf("CHAT_DeviceInit()--> Failed 0x%02x\r\n", ret);
    while(1);
  }

  //printf("BLE Stack Initialized & Device Configured\r\n");

  while(1) {
    /* BlueNRG-1 stack tick */
    BTLE_StackTick();

    /* Application tick */
    APP_Tick();

    if (uart_receive_cmd(buffer, BUF_SIZE)) {
    	uart_send_response(buffer, BUF_SIZE);
    	Process_InputData((uint8_t *)buffer, strnlen(buffer, BUF_SIZE));
    	clearStr(buffer);
    }
    bt_text = get_bt_text();
    if (bt_text) {
    	uart_send_response(bt_text, BUF_SIZE);
    }
  }
}

/* Hardware Error event.
   This event is used to notify the Host that a hardware failure has occurred in the Controller.
   Hardware_Code Values:
   - 0x01: Radio state error
   - 0x02: Timer overrun error
   - 0x03: Internal queue overflow error
   After this event is recommended to force device reset. */

void hci_hardware_error_event(uint8_t Hardware_Code)
{
   NVIC_SystemReset();
}

/**
  * This event is generated to report firmware error informations.
  * FW_Error_Type possible values:
  * Values:
  - 0x01: L2CAP recombination failure
  - 0x02: GATT unexpected response
  - 0x03: GATT unexpected request
    After this event with error type (0x01, 0x02, 0x3) it is recommended to disconnect.
*/
void aci_hal_fw_error_event(uint8_t FW_Error_Type,
                            uint8_t Data_Length,
                            uint8_t Data[])
{
  if (FW_Error_Type <= 0x03)
  {
    uint16_t connHandle;

    /* Data field is the connection handle where error has occurred */
    connHandle = LE_TO_HOST_16(Data);

    aci_gap_terminate(connHandle, BLE_ERROR_TERMINATED_REMOTE_USER);
  }
}

#ifdef USE_FULL_ASSERT
/*******************************************************************************
* Function Name  : assert_failed
* Description    : Reports the name of the source file and the source line number
*                  where the assert_param error has occurred.
* Input          : - file: pointer to the source file name
*                  - line: assert_param error line source number
* Output         : None
* Return         : None
*******************************************************************************/
void assert_failed(uint8_t* file, uint32_t line)
{
    /* User can add his own implementation to report the file name and line number,
    ex: printf("Wrong parameters value: file %s on line %d\r\n", file, line) */

    /* Infinite loop */
    while (1)
    {}
}
#endif

